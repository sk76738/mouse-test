#include "doutrou-layouts.dtsi"
#include <dt-bindings/zmk/matrix_transform.h>

/ {
    matrix_transform0: matrix_transform0 {
        compatible = "zmk,matrix-transform";
        columns = <6>;
        rows = <2>;
        map = <
            RC(0,0) RC(0,1) RC(0,2) RC(0,3) RC(0,4) RC(0,5) RC(1,0) RC(1,1) RC(1,2)
        >;
    };
};

&physical_layout_doutrou {
    transform = <&matrix_transform0>;
};
