#include "doutrou.dtsi"

/ {
    kscan0: kscan0 {
        compatible = "zmk,kscan-gpio-direct";
        wakeup-source;

        input-gpios
            = <&xiao_d 6 (GPIO_ACTIVE_LOW | GPIO_PULL_UP)>
            , <&xiao_d 7 (GPIO_ACTIVE_LOW | GPIO_PULL_UP)>
            , <&xiao_d 9 (GPIO_ACTIVE_LOW | GPIO_PULL_UP)>
            ;
    };
};

&matrix_transform0 {
    row-offset = <1>;
};

&physical_layout_doutrou {
    kscan = <&kscan0>;
};
