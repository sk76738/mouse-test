## boards/shields/doutrou/Kconfig.shield
```kconfig
config SHIELD_DOUTROU_LEFT
    def_bool $(shields_list_contains,doutrou_left)
  
config SHIELD_DOUTROU_RIGHT
    def_bool $(shields_list_contains,doutrou_right)
  
config SHIELD_DOUTROU_DONGLE
    def_bool $(shields_list_contains,doutrou_dongle)
```
